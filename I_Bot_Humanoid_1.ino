#include "BluetoothSerial.h"
BluetoothSerial ESP_BT;

#include <ESP32Servo.h>
#include <ESP32PWM.h>

#include <SPI.h>
#include <Wire.h>
#include <Adafruit_GFX.h>
#include <Adafruit_SSD1306.h>

// ---------------- MOTOR PINS ----------------
#define ENA  5
#define in1 15
#define in2 16
#define in3 17
#define in4 19
#define ENB 18

// ---------------- LED PINS ----------------
#define led1 4
#define led2 13

// ---------------- OLED ----------------
#define SCREEN_WIDTH 128
#define SCREEN_HEIGHT 64
#define OLED_RESET -1
Adafruit_SSD1306 display(SCREEN_WIDTH, SCREEN_HEIGHT, &Wire, OLED_RESET);

#define LOGO_HEIGHT   64
#define LOGO_WIDTH    128
// ---------------- SERVO ----------------
Servo motor_2;
Servo motor_3;

int servo2 = 150;
int servo3 = 20;

// ---------------- SPEED ----------------
int speedCar = 80;

// ---------------- ULTRASONIC ----------------
#define trigPin 14
#define echoPin 27
long duration;
int distance;

// ---------------- BLUETOOTH ----------------
int bt_data;
 const unsigned char epd_bitmap_shock [] PROGMEM = {
  0xff, 0xff, 0xff, 0xff, 0xff, 0xff, 0xff, 0xf0, 0x00, 0x00, 0x7f, 0xff, 0xff, 0xff, 0xff, 0xff, 
  0xff, 0xff, 0xff, 0xff, 0xff, 0xff, 0xfc, 0x00, 0x00, 0x00, 0x03, 0xff, 0xff, 0xff, 0xff, 0xff, 
  0xff, 0xff, 0xff, 0xff, 0xff, 0xff, 0xc0, 0x00, 0x00, 0x00, 0x00, 0x1f, 0xff, 0xff, 0xff, 0xff, 
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  0xff, 0xff, 0xff, 0xff, 0xff, 0xff, 0xff, 0xff, 0xff, 0xff, 0xff, 0xff, 0xff, 0xff, 0xfe, 0x07
 
};

// Array of all bitmaps for convenience. (Total bytes used to store images in PROGMEM = 1040)
const int epd_bitmap_allArray_LEN = 1;
const unsigned char* epd_bitmap_allArray[1] = {
  epd_bitmap_shock
};

const unsigned char epd_bitmap_laugh_1__1_ [] PROGMEM = {
  0xff, 0xff, 0xff, 0xff, 0xff, 0xff, 0xff, 0xff, 0xff, 0xff, 0xff, 0xff, 0xff, 0xff, 0xff, 0xff, 
  0xff, 0xff, 0xff, 0xff, 0xff, 0xff, 0xff, 0xff, 0xff, 0xff, 0xff, 0xff, 0xff, 0xff, 0xff, 0xff, 
  0xff, 0xff, 0xff, 0xff, 0xff, 0xff, 0xff, 0xff, 0xff, 0xff, 0xff, 0xff, 0xff, 0xff, 0xff, 0xff, 
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  0xff, 0xff, 0xff, 0xff, 0xff, 0xff, 0xff, 0xff, 0xff, 0xff, 0xff, 0xff, 0xff, 0xff, 0xff, 0xff
};



 //three face
 const unsigned char epd_bitmap_28_282956_toothy_plain_mouth_mouth_png__2_ [] PROGMEM = {
 0xff, 0xff, 0xff, 0xff, 0xff, 0xff, 0xff, 0xff, 0xff, 0xff, 0xff, 0xff, 0xff, 0xff, 0xff, 0xff, 
  0xff, 0xff, 0xff, 0xff, 0xff, 0xff, 0xff, 0xff, 0xff, 0xff, 0xff, 0xff, 0xff, 0xff, 0xff, 0xff, 
  0xff, 0xff, 0xff, 0xff, 0xff, 0xff, 0xff, 0xff, 0xff, 0xff, 0xff, 0xff, 0xff, 0xff, 0xff, 0xff, 
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  0xff, 0xff, 0xff, 0xff, 0xff, 0xff, 0xff, 0xff, 0xff, 0xff, 0xff, 0xff, 0xff, 0xff, 0xff, 0xff
};
 
 // four

 const unsigned char epd_bitmap_image__1___2_ [] PROGMEM = {
 0xff, 0xff, 0xff, 0xff, 0xff, 0xff, 0xff, 0xff, 0xff, 0xff, 0xff, 0xff, 0xff, 0xff, 0xff, 0xff, 
  0xff, 0xff, 0xff, 0xff, 0xff, 0xff, 0xff, 0xff, 0xff, 0xff, 0xff, 0xff, 0xff, 0xff, 0xff, 0xff, 
  0xff, 0xff, 0xff, 0xff, 0xff, 0xff, 0xff, 0xff, 0xff, 0xff, 0xff, 0xff, 0xff, 0xff, 0xff, 0xff, 
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  0xff, 0xff, 0xff, 0xff, 0xff, 0xff, 0xff, 0xff, 0xff, 0xff, 0xff, 0xff, 0xff, 0xff, 0xff, 0xff
};

// ---------------- SETUP ----------------
void setup() {
  Serial.begin(9600);
  ESP_BT.begin("humanoid bt");
  Serial.println("Bluetooth Device is Ready to Pair");

  // OLED
  if (!display.begin(SSD1306_SWITCHCAPVCC, 0x3C)) {
    Serial.println(F("SSD1306 allocation failed"));
    for (;;);
  }
  display.setRotation(2);
  testdrawbitmap();

  // Pin modes
  pinMode(ENA, OUTPUT);
  pinMode(ENB, OUTPUT);
  pinMode(in1, OUTPUT);
  pinMode(in2, OUTPUT);
  pinMode(in3, OUTPUT);
  pinMode(in4, OUTPUT);

  pinMode(trigPin, OUTPUT);
  pinMode(echoPin, INPUT);

  pinMode(led1, OUTPUT);
  pinMode(led2, OUTPUT);

  // ---- SERVO PWM FIX (IMPORTANT) ----
  ESP32PWM::allocateTimer(0);
  ESP32PWM::allocateTimer(1);
  ESP32PWM::allocateTimer(2);
  ESP32PWM::allocateTimer(3);

  motor_2.setPeriodHertz(50);
  motor_3.setPeriodHertz(50);

  motor_2.attach(32);
  motor_3.attach(33);

  motor_2.write(servo2);
  motor_3.write(servo3);
}

// ---------------- LOOP ----------------
void loop() {

  if (ESP_BT.available()) {
    bt_data = ESP_BT.read();
    Serial.println(bt_data);
    Serial.print("Received:"); Serial.println(bt_data);
  }

  // -------- MOVEMENT --------
  if (bt_data == 4) forword();
  else if (bt_data == 3) backword();
  else if (bt_data == 1) turnLeft();
  else if (bt_data == 2) turnRight();
  else if (bt_data == 5 || bt_data == 33) Stop();
  else if (bt_data == 22) dance();

  // -------- LED --------
  else if (bt_data == 61) ledon();
  else if (bt_data == 62) ledoff();

  // -------- SERVO 2 --------
  else if (bt_data == 13) {
    if (servo2 > 0) servo2 -= 1;
    motor_2.write(servo2);
  }
  else if (bt_data == 12) {
    if (servo2 < 180) servo2 += 1;
    motor_2.write(servo2);
  }

  // -------- SERVO 3 --------
  else if (bt_data == 15) {
    if (servo3 > 0) servo3 -= 1;
    motor_3.write(servo3);
  }
  else if (bt_data == 14) {
    if (servo3 < 180) servo3 += 1;
    motor_3.write(servo3);
  }

  // -------- ULTRASONIC (NON-BLOCKING) --------
  digitalWrite(trigPin, LOW);
  delayMicroseconds(2);
  digitalWrite(trigPin, HIGH);
  delayMicroseconds(10);
  digitalWrite(trigPin, LOW);

  duration = pulseIn(echoPin, HIGH, 25000);
  distance = duration * 0.034 / 2;

  if (bt_data == 40){
display.clearDisplay();

    display.drawBitmap(
    (display.width()  - LOGO_WIDTH ) / 2,
    (display.height() - LOGO_HEIGHT) / 2,
    epd_bitmap_shock, LOGO_WIDTH, LOGO_HEIGHT, 1);
    
  display.display();
  delay(1000);
  
  //second
  display.clearDisplay();
 
  display.drawBitmap(
    (display.width()  - LOGO_WIDTH ) / 2,
    (display.height() - LOGO_HEIGHT) / 2,
   epd_bitmap_laugh_1__1_, LOGO_WIDTH, LOGO_HEIGHT, 1);
    
  display.display();
  delay(1000);

  //three
    display.clearDisplay();
 
  display.drawBitmap(
    (display.width()  - LOGO_WIDTH ) / 2,
    (display.height() - LOGO_HEIGHT) / 2,
   epd_bitmap_28_282956_toothy_plain_mouth_mouth_png__2_, LOGO_WIDTH, LOGO_HEIGHT, 1);
    
  display.display();
  delay(1000);

  //four 
    display.clearDisplay();
 
  display.drawBitmap(
    (display.width()  - LOGO_WIDTH ) / 2,
    (display.height() - LOGO_HEIGHT) / 2,
  epd_bitmap_image__1___2_, LOGO_WIDTH, LOGO_HEIGHT, 1);
    
  display.display();
  delay(1000);
  
}
  if (bt_data == 41){
   
    display.clearDisplay();
  display.setTextSize(2);
  display.setTextColor(WHITE);
  display.setCursor(0,0);
  display.println("   ROBOT  ");
  display.setCursor(1,20);
  display.println(" SLEEPING");
   display.setCursor(2,40);
  display.println("   TIME");
  display.display();
  delay(1000);
  
  display.clearDisplay();
  display.setTextSize(2);
  display.setTextColor(WHITE);
   display.setCursor(0,0);
  display.println("   DON'T  ");
  display.setCursor(1,20);
  display.println("  DISTURB");
   display.setCursor(2,40);
  display.println("     ME");
  display.display();
  delay(1000);
  display.clearDisplay();
  }
  // -------- AUTO MODE --------
  if (bt_data == 23) {
    if (distance > 10) forword();
    else {
      Stop();
      delay(300);
      backword();
      delay(500);
      turnRight();
      delay(500);
    }
  }

  if (bt_data == 24) Stop();

  delay(2); // ⚠️ Reduced delay for servo responsiveness
}

// ---------------- FUNCTIONS ----------------
void ledon() {
  digitalWrite(led1, HIGH);
  digitalWrite(led2, HIGH);
}

void ledoff() {
  digitalWrite(led1, LOW);
  digitalWrite(led2, LOW);
}

void forword() {
  analogWrite(ENA, speedCar);
  analogWrite(ENB, speedCar);
  digitalWrite(in1, LOW);
  digitalWrite(in2, HIGH);
  digitalWrite(in3, LOW);
  digitalWrite(in4, HIGH);
}

void backword() {
  analogWrite(ENA, speedCar);
  analogWrite(ENB, speedCar);
  digitalWrite(in1, HIGH);
  digitalWrite(in2, LOW);
  digitalWrite(in3, HIGH);
  digitalWrite(in4, LOW);
}

void turnLeft() {
  analogWrite(ENA, speedCar);
  analogWrite(ENB, speedCar);
  digitalWrite(in1, LOW);
  digitalWrite(in2, HIGH);
  digitalWrite(in3, HIGH);
  digitalWrite(in4, LOW);
}

void turnRight() {
  analogWrite(ENA, speedCar);
  analogWrite(ENB, speedCar);
  digitalWrite(in1, HIGH);
  digitalWrite(in2, LOW);
  digitalWrite(in3, LOW);
  digitalWrite(in4, HIGH);
}

void Stop() {
  digitalWrite(in1, LOW);
  digitalWrite(in2, LOW);
  digitalWrite(in3, LOW);
  digitalWrite(in4, LOW);
}

void dance() {
  for (int i = 0; i < 2; i++) {
    turnLeft(); delay(400);
    turnRight(); delay(400);
  }
  Stop();
}

void testdrawbitmap() {
  display.clearDisplay();
  display.setTextSize(2);
  display.setTextColor(WHITE);
  display.setCursor(0, 0);
  display.println(" FOR ROBOT ");
  display.setCursor(0, 20);
  display.println(" WAKE UP ");
  display.setCursor(0, 40);
  display.println(" PRESS D.P ");
  display.display();
}
